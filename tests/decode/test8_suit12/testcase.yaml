## tests/decode/test8_suit12/testcase.yaml
```yaml
tests:
  zcbor.decode.test8_suit12:
    platform_allow:
      - native_sim
      - native_sim/native/64
      - mps2/an521/cpu0
      - qemu_malta/qemu_malta/be
    tags:
      - zcbor
      - decode
      - test8
  zcbor.decode.test8_suit12.unordered_maps:
    platform_allow:
      - native_sim
      - native_sim/native/64
      - mps2/an521/cpu0
      - qemu_malta/qemu_malta/be
    tags:
      - zcbor
      - decode
      - test8
      - unordered_map
    extra_args:
      - UNORDERED_MAPS=ON
```

## tests/encode/test5_defines/testcase.yaml
```yaml
common:
  platform_allow:
    - native_sim
    - native_sim/native/64
    - mps2/an521/cpu0
    - qemu_malta/qemu_malta/be
  tags:
    - zcbor
    - encode
    - decode
    - defines
    - test5

tests:
  zcbor.encode.test5_defines: {}
  zcbor.encode.test5_defines.canonical:
    extra_args: CANONICAL=ON
```

## tests/unit/test4_boundary/testcase.yaml
```yaml
common:
  platform_allow:
    - native_sim
    - native_sim/native/64
    - mps2/an521/cpu0
    - qemu_malta/qemu_malta/be
  tags:
    - zcbor
    - unit
  timeout: 120

tests:
  zcbor.unit.test4_boundary: {}
  zcbor.unit.test4_boundary.canonical:
    extra_args: CANONICAL=ON
```
