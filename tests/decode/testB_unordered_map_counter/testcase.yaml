## tests/decode/testB_unordered_map_counter/testcase.yaml
```yaml
tests:
  zcbor.decode.testB_unordered_map_counter:
    platform_allow:
      - native_sim
      - native_sim/native/64
      - mps2/an521/cpu0
      - qemu_malta/qemu_malta/be
    tags:
      - zcbor
      - decode
      - unordered_map
      - testB
```
