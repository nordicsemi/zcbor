## tests/decode/test1_suit_old_formats/testcase.yaml
```yaml
tests:
  zcbor.decode.test1_suit_old_formats:
    platform_allow: native_posix native_posix/native/64 mps2/an521/cpu0 qemu_malta/qemu_malta/be
    tags: zcbor decode test1
```

## tests/decode/test2_suit/testcase.yaml
```yaml
tests:
  zcbor.decode.test2_suit:
    platform_allow: native_posix native_posix/native/64 mps2/an521/cpu0 qemu_malta/qemu_malta/be
    tags: zcbor decode test2
```

## tests/decode/test3_simple/testcase.yaml
```yaml
tests:
  zcbor.decode.test3_simple:
    platform_allow: native_posix native_posix/native/64 mps2/an521/cpu0 qemu_malta/qemu_malta/be
    tags: zcbor decode test3
```

## tests/decode/test5_corner_cases/testcase.yaml
```yaml
tests:
  zcbor.decode.test5_corner_cases:
    platform_allow: native_posix native_posix/native/64 mps2/an521/cpu0 qemu_malta/qemu_malta/be
    tags: zcbor decode test5
  zcbor.decode.test5_corner_cases.indefinite_length_arrays:
    platform_allow: native_posix native_posix/native/64 mps2/an521/cpu0 qemu_malta/qemu_malta/be
    tags: zcbor decode test5 indefinite
    extra_args: TEST_INDEFINITE_LENGTH_ARRAYS=1
```

## tests/decode/test7_suit9_simple/testcase.yaml
```yaml
tests:
  zcbor.decode.test7_suit9_simple:
    platform_allow: native_posix native_posix/native/64 mps2/an521/cpu0 qemu_malta/qemu_malta/be
    tags: zcbor decode test7
```

## tests/decode/test9_manifest14/testcase.yaml
```yaml
tests:
  zcbor.decode.test9_manifest14:
    platform_allow: native_posix native_posix/native/64 mps2/an521/cpu0 qemu_malta/qemu_malta/be
    tags: zcbor decode manifest14 test9
  zcbor.cbor_decode.test9_manifest16.canonical:
    platform_allow: native_posix native_posix/native/64 mps2/an521/cpu0 qemu_malta/qemu_malta/be
    tags: zcbor decode manifest16 test9 canonical
    extra_args: MANIFEST=manifest16 CANONICAL=ON
```

## tests/decode/testA_unordered_map/testcase.yaml
```yaml
tests:
  zcbor.decode.testA_unordered_map:
    platform_allow:
      - native_sim
      - native_sim/native/64
      - mps2/an521/cpu0
      - qemu_malta/qemu_malta/be
    tags:
      - zcbor
      - decode
      - unordered_map
      - testA
```

## tests/encode/test2_simple/testcase.yaml
```yaml
tests:
  zcbor.encode.test2_simple:
    platform_allow: native_posix native_posix/native/64 mps2/an521/cpu0 qemu_malta/qemu_malta/be
    tags: zcbor encode test
  zcbor.encode.test2_simple.canonical:
    platform_allow: native_posix native_posix/native/64 mps2/an521/cpu0 qemu_malta/qemu_malta/be
    tags: zcbor encode canonical test
    extra_args: CANONICAL=CANONICAL
```

## tests/encode/test3_corner_cases/testcase.yaml
```yaml
tests:
  zcbor.encode.test3_corner_cases:
    platform_allow: native_posix native_posix/native/64 mps2/an521/cpu0 qemu_malta/qemu_malta/be
    tags: zcbor encode test3
  zcbor.encode.test3_corner_cases.canonical:
    platform_allow: native_posix native_posix/native/64 mps2/an521/cpu0 qemu_malta/qemu_malta/be
    tags: zcbor encode canonical test3
    extra_args: CANONICAL=CANONICAL
```

## tests/encode/test4_senml/testcase.yaml
```yaml
tests:
  zcbor.encode.test4_senml:
    platform_allow: native_posix native_posix/native/64 mps2/an521/cpu0 qemu_malta/qemu_malta/be
    tags: zcbor encode test4
  zcbor.encode.test4_senml.canonical:
    platform_allow: native_posix native_posix/native/64 mps2/an521/cpu0 qemu_malta/qemu_malta/be
    tags: zcbor encode canonical test4
    extra_args: CANONICAL=CANONICAL
```

## tests/unit/test1_unit_tests/testcase.yaml
```yaml
common:
  platform_allow: native_posix native_posix/native/64 mps2/an521/cpu0 qemu_malta/qemu_malta/be
  tags: zcbor unit
  timeout: 120  # Because of test_size64

tests:
  zcbor.unit.test1: {}
  zcbor.unit.test1.map_smart_search:
    extra_args: MAP_SMART_SEARCH=ON
  zcbor.unit.test1.canonical:
    extra_args: CANONICAL=ON
```

## tests/unit/test2_cpp/testcase.yaml
```yaml
tests:
  zcbor.unit.test2:
    platform_allow: mps2/an521/cpu0 qemu_malta/qemu_malta/be
    tags: zcbor unit cpp
common: 
  harness: console
  harness_config:
    type: multi_line
    regex:
      - "Success!"
```

## tests/unit/test3_float16/testcase.yaml
```yaml
tests:
  zcbor.unit.test3:
    platform_allow: native_posix native_posix/native/64
    tags: zcbor unit float16
    timeout: 240
  zcbor.unit.test3.release:
    platform_allow: mps2/an521/cpu0 qemu_malta/qemu_malta/be
    tags: zcbor unit float16 release
    timeout: 7200
```
